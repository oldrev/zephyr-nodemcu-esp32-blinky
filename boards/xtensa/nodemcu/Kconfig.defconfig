## boards/xtensa/nodemcu/Kconfig.defconfig
```kconfig
# ESP32 board configuration

# Copyright (c) 2017 Intel Corporation
# SPDX-License-Identifier: Apache-2.0

config BOARD
	default "nodemcu"
	depends on BOARD_NODEMCU

config ENTROPY_ESP32_RNG
	default y if ENTROPY_GENERATOR
```
